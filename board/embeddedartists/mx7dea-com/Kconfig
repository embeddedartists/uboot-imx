## board/embeddedartists/mx7dea-com/Kconfig
```kconfig
if TARGET_MX7DEA_COM || TARGET_MX7DEA_UCOM

config SYS_BOARD
	default "mx7dea-com"

config SYS_VENDOR
	default "embeddedartists"

config SYS_SOC
	default "mx7"

config SYS_CONFIG_NAME
	default "mx7dea-com"

config IMX_CONFIG
	default "board/embeddedartists/mx7dea-com/imximage.cfg"

endif
```

## board/embeddedartists/mx8mmea-som/Kconfig
```kconfig
if TARGET_MX8MMEA_SOM

config SYS_BOARD
	default "mx8mmea-som"

config SYS_VENDOR
	default "embeddedartists"

config SYS_CONFIG_NAME
	default "mx8mmea-som"

config IMX_CONFIG
	default "board/embeddedartists/mx8mmea-som/imximage-8mm-lpddr4.cfg"

endif
```

## board/embeddedartists/mx8mpea-som/Kconfig
```kconfig
if TARGET_MX8MPEA_SOM

config SYS_BOARD
	default "mx8mpea-som"

config SYS_VENDOR
	default "embeddedartists"

config SYS_CONFIG_NAME
	default "mx8mpea-som"

config IMX_CONFIG
	default "board/embeddedartists/mx8mpea-som/imximage-8mp-lpddr4.cfg"

config IMX8MP_GP5_LOCK_UPDATE
	bool "Enable burn GP5_LOCK fuse at boot"
	help
	  Select to check the GP5_LOCK fuse and burn it to WP+OP

endif
```
