## board/embeddedartists/common/Kconfig
```kconfig
config EA_NO_UART_FLUSH
	bool "Disable flush of UART at boot"
	default n

config EA_IMX_PTP
	bool "Enable when using EA test platform"
	default n
	help
	  Enable this option when building a u-boot for the EA
	  test platform
```

## board/embeddedartists/mx6qea-com/Kconfig
```kconfig
if TARGET_MX6QEA_COM || TARGET_MX6DLEA_COM

config SYS_BOARD
	default "mx6qea-com"

config SYS_VENDOR
	default "embeddedartists"

config SYS_SOC
	default "mx6"

config SYS_CONFIG_NAME
	default "mx6qea-com"

config SYS_TEXT_BASE
    default 0x17800000

endif
```

## board/embeddedartists/mx6sxea-com/Kconfig
```kconfig
if TARGET_MX6SXEA_COM

config SYS_BOARD
	default "mx6sxea-com"

config SYS_VENDOR
	default "embeddedartists"

config SYS_SOC
	default "mx6"

config SYS_CONFIG_NAME
	default "mx6sxea-com"

endif
```

## board/embeddedartists/mx6ulea-com/Kconfig
```kconfig
if TARGET_MX6ULEA_COM || TARGET_MX6ULLEA_COM

config SYS_BOARD
	default "mx6ulea-com"

config SYS_VENDOR
	default "embeddedartists"

config SYS_SOC
	default "mx6"

config SYS_CONFIG_NAME
	default "mx6ulea-com"

config IMX_CONFIG
	default "board/embeddedartists/mx6ulea-com/imximage.cfg"

config SYS_TEXT_BASE
        default 0x87800000
endif
```

## board/embeddedartists/mx7dea-ucom/Kconfig
```kconfig
if TARGET_MX7DEA_UCOM

config SYS_BOARD
	default "mx7dea-ucom"

config SYS_VENDOR
	default "embeddedartists"

config SYS_SOC
	default "mx7"

config SYS_CONFIG_NAME
	default "mx7dea-ucom"

endif
```

## board/embeddedartists/mx7ulpea-ucom/Kconfig
```kconfig
if TARGET_MX7ULPEA_UCOM

config SYS_BOARD
	default "mx7ulpea-ucom"

config SYS_VENDOR
	default "embeddedartists"

config SYS_CONFIG_NAME
	default "mx7ulpea-ucom"

config IMX_CONFIG
	default "board/embeddedartists/mx7ulpea-ucom/imximage.cfg"

endif
```

## board/embeddedartists/mx8mmea-ucom/Kconfig
```kconfig
if TARGET_MX8MMEA_UCOM

config SYS_BOARD
	default "mx8mmea-ucom"

config SYS_VENDOR
	default "embeddedartists"

config SYS_CONFIG_NAME
	default "mx8mmea-ucom"

endif
```

## board/embeddedartists/mx8mnea-ucom/Kconfig
```kconfig
if TARGET_MX8MNEA_UCOM

config SYS_BOARD
	default "mx8mnea-ucom"

config SYS_VENDOR
	default "embeddedartists"

config SYS_CONFIG_NAME
	default "mx8mnea-ucom"

endif
```

## board/embeddedartists/mx8mqea-com/Kconfig
```kconfig
if TARGET_MX8MQEA_COM

config SYS_BOARD
	default "mx8mqea-com"

config SYS_VENDOR
	default "embeddedartists"

config SYS_CONFIG_NAME
	default "mx8mqea-com"

endif
```

## board/embeddedartists/mx93ea-ucom/Kconfig
```kconfig
if TARGET_MX93EA_UCOM

config SYS_BOARD
	default "mx93ea-ucom"

config SYS_VENDOR
	default "embeddedartists"

config SYS_CONFIG_NAME
	default "mx93ea-ucom"

config IMX93_EA_LPDDR4X
	bool "Using LPDDR4X Timing and PMIC voltage"
	default y
	select IMX9_LPDDR4X
	help
	  Select the LPDDR4X timing and 0.6V VDDQ

endif
```

## configs/mx6dlea-com-android_defconfig
```kconfig
#CONFIG_SPL=y
CONFIG_SYS_EXTRA_OPTIONS="IMX_CONFIG=board/embeddedartists/mx6qea-com/imximage_mx6dl.cfg,MX6DL,ANDROID_SUPPORT"
CONFIG_ARM=y
CONFIG_TARGET_MX6QEA_COM=y
CONFIG_DM=y
CONFIG_DM_THERMAL=y
```

## configs/mx6dlea-com-ptp_defconfig
```kconfig
CONFIG_SYS_EXTRA_OPTIONS="IMX_CONFIG=board/embeddedartists/mx6qea-com/imximage_mx6dl.cfg,MX6DL,EA_NO_UART_FLUSH,EA_IMX_PTP"
CONFIG_ARM=y
CONFIG_ARCH_MX6=y
CONFIG_TARGET_MX6QEA_COM=y
```

## configs/mx6dlea-com_defconfig
```kconfig
CONFIG_SYS_EXTRA_OPTIONS="IMX_CONFIG=board/embeddedartists/mx6qea-com/imximage_mx6dl.cfg"
CONFIG_ARM=y
CONFIG_ARCH_MX6=y
CONFIG_TARGET_MX6DLEA_COM=y

CONFIG_SPL_GPIO_SUPPORT=y
CONFIG_SPL_LIBCOMMON_SUPPORT=y
CONFIG_SPL_LIBGENERIC_SUPPORT=y
CONFIG_SPL_MMC_SUPPORT=y
CONFIG_SPL_SERIAL_SUPPORT=y
CONFIG_SPL_LIBDISK_SUPPORT=y
CONFIG_SPL_WATCHDOG_SUPPORT=y
CONFIG_SPL=y
CONFIG_SPL_EXT_SUPPORT=y
CONFIG_SPL_I2C_SUPPORT=y
CONFIG_SPL_BOARD_INIT=y

CONFIG_MXC_UART=y
CONFIG_IMX_THERMAL=y

CONFIG_VIDEO=y
CONFIG_VIDEO_IPUV3=y
CONFIG_BOOTDELAY=3
# CONFIG_CONSOLE_MUX is not set
CONFIG_SYS_CONSOLE_IS_IN_ENV=y
CONFIG_SYS_CONSOLE_OVERWRITE_ROUTINE=y
CONFIG_HUSH_PARSER=y
CONFIG_CMD_BOOTZ=y
# CONFIG_CMD_IMLS is not set
# CONFIG_CMD_FLASH is not set
CONFIG_CMD_DFU=y
CONFIG_CMD_MMC=y
CONFIG_CMD_I2C=y
CONFIG_CMD_USB=y
CONFIG_CMD_USB_MASS_STORAGE=y
CONFIG_CMD_GPIO=y
CONFIG_CMD_DHCP=y
CONFIG_CMD_MII=y
CONFIG_CMD_PING=y
CONFIG_CMD_CACHE=y
CONFIG_CMD_EXT2=y
CONFIG_CMD_EXT4=y
CONFIG_CMD_EXT4_WRITE=y
CONFIG_CMD_FAT=y
CONFIG_DFU_MMC=y
CONFIG_DFU_RAM=y
CONFIG_DEFAULT_DEVICE_TREE="imx6dlea-com-kit"
CONFIG_OF_CONTROL=y
CONFIG_OF_BOARD_FIXUP=y
CONFIG_DM_ETH=y
CONFIG_DM_GPIO=y
CONFIG_DM_I2C=y
CONFIG_DM_MMC=y
CONFIG_PINCTRL=y
CONFIG_PINCTRL_IMX6=y
CONFIG_DM_PMIC=y
CONFIG_DM_PMIC_PFUZE100=y
CONFIG_DM_REGULATOR=y
CONFIG_DM_REGULATOR_PFUZE100=y
CONFIG_DM_REGULATOR_FIXED=y
CONFIG_DM_REGULATOR_GPIO=y
CONFIG_DM_USB=y

CONFIG_CMD_FS_GENERIC=y
CONFIG_CMD_SAVEENV=y
CONFIG_ENV_IS_IN_MMC=y
CONFIG_USB=y
CONFIG_USB_STORAGE=y
CONFIG_USB_GADGET=y
CONFIG_CI_UDC=y
CONFIG_USB_GADGET_DOWNLOAD=y
CONFIG_USB_GADGET_MANUFACTURER="FSL"
CONFIG_USB_GADGET_VENDOR_NUM=0x0525
CONFIG_USB_GADGET_PRODUCT_NUM=0xa4a5
# CONFIG_VIDEO_SW_CURSOR is not set
CONFIG_OF_LIBFDT=y

CONFIG_CMD_EADISP=y

CONFIG_CMD_FASTBOOT=y
CONFIG_USB_FUNCTION_FASTBOOT=y
CONFIG_FSL_FASTBOOT=y
CONFIG_FASTBOOT=y
CONFIG_FASTBOOT_BUF_ADDR=0x12C00000
CONFIG_FASTBOOT_BUF_SIZE=0x40000000
CONFIG_FASTBOOT_FLASH=y
CONFIG_FASTBOOT_FLASH_MMC_DEV=1
CONFIG_EFI_PARTITION=y
```

## configs/mx6qea-com-android_defconfig
```kconfig
#CONFIG_SPL=y
CONFIG_SYS_EXTRA_OPTIONS="IMX_CONFIG=board/embeddedartists/mx6qea-com/imximage.cfg,MX6Q,ANDROID_SUPPORT"
CONFIG_ARM=y
CONFIG_TARGET_MX6QEA_COM=y
CONFIG_SYS_MALLOC_F=y
CONFIG_SYS_MALLOC_F_LEN=0x400
CONFIG_DM=y
CONFIG_DM_THERMAL=y
```

## configs/mx6qea-com_defconfig
```kconfig
CONFIG_SPL=y
CONFIG_SYS_EXTRA_OPTIONS="IMX_CONFIG=board/embeddedartists/mx6qea-com/imximage.cfg,MX6Q"
CONFIG_ARM=y
CONFIG_ARCH_MX6=y
CONFIG_TARGET_MX6QEA_COM=y
```

## configs/mx6sxea-com-android_defconfig
```kconfig
#CONFIG_SPL=y
CONFIG_SYS_EXTRA_OPTIONS="IMX_CONFIG=board/embeddedartists/mx6sxea-com/imximage.cfg,MX6SX,ANDROID_SUPPORT"
CONFIG_ARM=y
CONFIG_TARGET_MX6SXEA_COM=y
CONFIG_SYS_MALLOC_F=y
CONFIG_SYS_MALLOC_F_LEN=0x400
CONFIG_DM=y
CONFIG_DM_THERMAL=y
```

## configs/mx6sxea-com-mfg_defconfig
```kconfig
CONFIG_SYS_EXTRA_OPTIONS="IMX_CONFIG=board/embeddedartists/mx6sxea-com/imximage.cfg,MX6SX,EA_NO_UART_FLUSH"
CONFIG_ARM=y
CONFIG_ARCH_MX6=y
CONFIG_TARGET_MX6SXEA_COM=y

CONFIG_MXC_UART=y

# CONFIG_CONSOLE_MUX is not set
CONFIG_SYS_CONSOLE_IS_IN_ENV=y
CONFIG_HUSH_PARSER=y
CONFIG_CMD_BOOTZ=y
# CONFIG_CMD_IMLS is not set
# CONFIG_CMD_FLASH is not set
CONFIG_CMD_MMC=y
CONFIG_CMD_I2C=y
CONFIG_CMD_USB=y
CONFIG_CMD_GPIO=y
CONFIG_CMD_DHCP=y
CONFIG_CMD_MII=y
CONFIG_CMD_PING=y
CONFIG_CMD_CACHE=y
CONFIG_CMD_EXT2=y
CONFIG_CMD_EXT4=y
CONFIG_CMD_EXT4_WRITE=y
CONFIG_CMD_FAT=y
CONFIG_CMD_FS_GENERIC=y
CONFIG_USB=y
CONFIG_USB_STORAGE=y
CONFIG_USB_GADGET=y
# CONFIG_VIDEO_SW_CURSOR is not set
CONFIG_OF_LIBFDT=y
```

## configs/mx6sxea-com-ptp_defconfig
```kconfig
CONFIG_SYS_EXTRA_OPTIONS="IMX_CONFIG=board/embeddedartists/mx6sxea-com/imximage.cfg"
CONFIG_ARM=y
CONFIG_ARCH_MX6=y
CONFIG_TARGET_MX6SXEA_COM=y
CONFIG_IMX_RDC=y

CONFIG_SPL_GPIO_SUPPORT=y
CONFIG_SPL_LIBCOMMON_SUPPORT=y
CONFIG_SPL_LIBGENERIC_SUPPORT=y
CONFIG_SPL_MMC_SUPPORT=y
CONFIG_SPL_SERIAL_SUPPORT=y
CONFIG_SPL_LIBDISK_SUPPORT=y
CONFIG_SPL_WATCHDOG_SUPPORT=y
CONFIG_SPL=y
CONFIG_SPL_EXT_SUPPORT=y
CONFIG_SPL_I2C_SUPPORT=y
CONFIG_SPL_BOARD_INIT=y

CONFIG_MXC_UART=y
CONFIG_IMX_THERMAL=y
CONFIG_IMX_BOOTAUX=y

CONFIG_VIDEO=y
CONFIG_BOOTDELAY=3
# CONFIG_CONSOLE_MUX is not set
CONFIG_SYS_CONSOLE_IS_IN_ENV=y
CONFIG_HUSH_PARSER=y
CONFIG_CMD_BOOTZ=y
# CONFIG_CMD_IMLS is not set
# CONFIG_CMD_FLASH is not set
CONFIG_CMD_DFU=y
CONFIG_CMD_MMC=y
CONFIG_CMD_I2C=y
CONFIG_CMD_USB=y
CONFIG_CMD_USB_MASS_STORAGE=y
CONFIG_CMD_GPIO=y
CONFIG_CMD_DHCP=y
CONFIG_CMD_MII=y
CONFIG_CMD_PING=y
CONFIG_CMD_CACHE=y
CONFIG_CMD_EXT2=y
CONFIG_CMD_EXT4=y
CONFIG_CMD_EXT4_WRITE=y
CONFIG_CMD_FAT=y
CONFIG_DFU_MMC=y
CONFIG_PINCTRL=y
CONFIG_PINCTRL_IMX6=y
CONFIG_DFU_RAM=y
CONFIG_DEFAULT_DEVICE_TREE="imx6sxea-com-kit"
CONFIG_DM_ETH=y
CONFIG_DM_GPIO=y
CONFIG_DM_I2C=y
CONFIG_DM_MMC=y
CONFIG_DM_PMIC_PFUZE100=y
CONFIG_DM_PMIC=y
CONFIG_DM_REGULATOR_FIXED=y
CONFIG_DM_REGULATOR_GPIO=y
CONFIG_DM_REGULATOR_PFUZE100=y
CONFIG_DM_REGULATOR=y
CONFIG_DM_SPI=y
CONFIG_DM_SPI_FLASH=y
CONFIG_DM_USB=y
CONFIG_CMD_FS_GENERIC=y
CONFIG_CMD_SAVEENV=y
CONFIG_ENV_IS_IN_MMC=y
CONFIG_CMD_TIME=y
CONFIG_CMD_SF=y

CONFIG_USB=y
CONFIG_USB_STORAGE=y
#CONFIG_USB_HOST_ETHER=y
#CONFIG_USB_ETHER_ASIX=y
CONFIG_USB_GADGET=y
CONFIG_USB_GADGET_DOWNLOAD=y
CONFIG_USB_GADGET_MANUFACTURER="FSL"
CONFIG_USB_GADGET_VENDOR_NUM=0x0525
CONFIG_USB_GADGET_PRODUCT_NUM=0xa4a5
CONFIG_CI_UDC=y
# CONFIG_VIDEO_SW_CURSOR is not set
CONFIG_OF_LIBFDT=y
CONFIG_OF_CONTROL=y
CONFIG_OF_BOARD_FIXUP=y
CONFIG_SPI_FLASH=y
CONFIG_SPI_FLASH_BAR=y
CONFIG_SPI_FLASH_SPANSION=y
CONFIG_SPI_FLASH_STMICRO=y
CONFIG_SPI_FLASH_ISSI=y
CONFIG_PHYLIB=y

CONFIG_FSL_QSPI=y
CONFIG_CMD_EADISP=y

CONFIG_CMD_FASTBOOT=y
CONFIG_USB_FUNCTION_FASTBOOT=y
CONFIG_FSL_FASTBOOT=y
CONFIG_FASTBOOT=y
CONFIG_FASTBOOT_BUF_ADDR=0x83800000
CONFIG_FASTBOOT_BUF_SIZE=0x40000000
CONFIG_FASTBOOT_FLASH=y
CONFIG_FASTBOOT_FLASH_MMC_DEV=1
CONFIG_EFI_PARTITION=y
CONFIG_EA_IMX_PTP=y
```

## configs/mx6sxea-com_defconfig
```kconfig
CONFIG_SPL=y
CONFIG_SYS_EXTRA_OPTIONS="IMX_CONFIG=board/embeddedartists/mx6sxea-com/imximage.cfg,MX6SX"
CONFIG_ARM=y
CONFIG_ARCH_MX6=y
CONFIG_TARGET_MX6SXEA_COM=y
CONFIG_IMX_RDC=y
```

## configs/mx6ulea-com-mfg_defconfig
```kconfig
CONFIG_SYS_EXTRA_OPTIONS="IMX_CONFIG=board/embeddedartists/mx6ulea-com/imximage.cfg,MX6UL,EA_NO_UART_FLUSH"
CONFIG_ARM=y
CONFIG_ARCH_MX6=y
CONFIG_TARGET_MX6ULEA_COM=y
```

## configs/mx6ulea-com_defconfig
```kconfig
CONFIG_SYS_EXTRA_OPTIONS="IMX_CONFIG=board/embeddedartists/mx6ulea-com/imximage.cfg"
CONFIG_ARM=y
CONFIG_ARCH_MX6=y
CONFIG_TARGET_MX6ULEA_COM=y
CONFIG_ENV_SIZE=0x2000
CONFIG_ENV_OFFSET=0x1FE000
CONFIG_SPL_GPIO_SUPPORT=y
CONFIG_SPL_LIBCOMMON_SUPPORT=y
CONFIG_SPL_LIBGENERIC_SUPPORT=y
CONFIG_SPL_MMC_SUPPORT=y
CONFIG_SPL_SERIAL_SUPPORT=y
CONFIG_SPL_LIBDISK_SUPPORT=y
CONFIG_SPL_WATCHDOG_SUPPORT=y
CONFIG_SPL=y
CONFIG_SPL_EXT_SUPPORT=y
CONFIG_SPL_I2C_SUPPORT=y
CONFIG_SPL_BOARD_INIT=y
CONFIG_SPL_TEXT_BASE=0x00908000

CONFIG_MXC_UART=y
CONFIG_IMX_THERMAL=y

CONFIG_VIDEO=y
CONFIG_BOOTDELAY=3
# CONFIG_CONSOLE_MUX is not set
CONFIG_SYS_CONSOLE_IS_IN_ENV=y
CONFIG_BOARD_EARLY_INIT_F=y
CONFIG_HUSH_PARSER=y
CONFIG_CMD_BOOTZ=y
# CONFIG_CMD_IMLS is not set
# CONFIG_CMD_FLASH is not set
CONFIG_CMD_MMC=y
CONFIG_CMD_I2C=y
CONFIG_CMD_USB=y
CONFIG_CMD_USB_MASS_STORAGE=y
CONFIG_CMD_GPIO=y
CONFIG_CMD_DHCP=y
CONFIG_CMD_MII=y
CONFIG_CMD_PING=y
CONFIG_CMD_CACHE=y
CONFIG_CMD_EXT2=y
CONFIG_CMD_EXT4=y
CONFIG_CMD_EXT4_WRITE=y
CONFIG_CMD_FAT=y
CONFIG_CMD_FS_GENERIC=y
CONFIG_CMD_BMP=y
CONFIG_CMD_MEMTEST=y
CONFIG_CMD_NET=y
CONFIG_DEFAULT_DEVICE_TREE="imx6ulea-com-kit"
CONFIG_DM_ETH=y
CONFIG_DM_ETH_PHY=y
CONFIG_FEC_MXC=y
CONFIG_MII=y
CONFIG_DM_GPIO=y
CONFIG_NR_DRAM_BANKS=1
CONFIG_DM_I2C=y
CONFIG_DM_MMC=y
CONFIG_FSL_USDHC=y
CONFIG_DM_PMIC_PFUZE100=y
CONFIG_DM_PMIC=y
CONFIG_DM_REGULATOR_FIXED=y
CONFIG_DM_REGULATOR_GPIO=y
CONFIG_DM_REGULATOR_PFUZE100=y
CONFIG_DM_REGULATOR=y
CONFIG_DM_USB=y
CONFIG_CMD_SAVEENV=y
CONFIG_ENV_IS_IN_MMC=y
CONFIG_SYS_RELOC_GD_ENV_ADDR=y
CONFIG_PHYLIB=y
CONFIG_PHY_MICREL=y
CONFIG_PHY_MICREL_KSZ8XXX=y
CONFIG_PINCTRL=y
CONFIG_PINCTRL_IMX6=y
CONFIG_USB=y
CONFIG_USB_STORAGE=y
CONFIG_OF_LIBFDT=y
CONFIG_OF_CONTROL=y
CONFIG_OF_BOARD_FIXUP=y

# CONFIG_DM_VIDEO is not set
# CONFIG_SYS_WHITE_ON_BLACK is not set

CONFIG_CMD_EADISP=y

CONFIG_CMD_FASTBOOT=y
CONFIG_CI_UDC=y
CONFIG_USB_GADGET=y
CONFIG_USB_FUNCTION_FASTBOOT=y
CONFIG_USB_GADGET_DOWNLOAD=y
CONFIG_USB_GADGET_MANUFACTURER="FSL"
CONFIG_USB_GADGET_VENDOR_NUM=0x0525
CONFIG_USB_GADGET_PRODUCT_NUM=0xa4a5

CONFIG_FASTBOOT_UUU_SUPPORT=y
CONFIG_FASTBOOT=y
CONFIG_FASTBOOT_BUF_ADDR=0x83800000
CONFIG_FASTBOOT_BUF_SIZE=0x40000000
CONFIG_FASTBOOT_FLASH=y
CONFIG_EFI_PARTITION=y
```

## configs/mx7dea-com_defconfig
```kconfig
CONFIG_SYS_EXTRA_OPTIONS="IMX_CONFIG=board/embeddedartists/mx7dea-com/imximage.cfg"
CONFIG_ARM=y
CONFIG_ARCH_MX7=y
CONFIG_TARGET_MX7DEA_COM=y
CONFIG_NR_DRAM_BANKS=1
CONFIG_ENV_SIZE=0x2000
CONFIG_ENV_OFFSET=0x1FE000
CONFIG_ARMV7_BOOT_SEC_DEFAULT=y
CONFIG_IMX_RDC=y

CONFIG_SPL_TEXT_BASE=0x00911000
CONFIG_SPL_GPIO_SUPPORT=y
CONFIG_SPL_LIBCOMMON_SUPPORT=y
CONFIG_SPL_LIBGENERIC_SUPPORT=y
CONFIG_SPL_MMC_SUPPORT=y
CONFIG_SPL_SERIAL_SUPPORT=y
CONFIG_SPL_LIBDISK_SUPPORT=y
CONFIG_SPL_WATCHDOG_SUPPORT=y
CONFIG_SPL=y
CONFIG_SPL_EXT_SUPPORT=y
CONFIG_SPL_I2C_SUPPORT=y
CONFIG_SPL_BOARD_INIT=y

CONFIG_IMX_BOOTAUX=y
CONFIG_VIDEO=y
CONFIG_BOOTDELAY=3
# CONFIG_CONSOLE_MUX is not set
CONFIG_SYS_CONSOLE_IS_IN_ENV=y
CONFIG_HUSH_PARSER=y
CONFIG_CMD_BOOTZ=y
# CONFIG_CMD_IMLS is not set
# CONFIG_CMD_FLASH is not set
# CONFIG_CMD_BMODE is not set
CONFIG_CMD_MEMTEST=y
CONFIG_CMD_DFU=y
CONFIG_CMD_MMC=y
CONFIG_CMD_SF=y
CONFIG_CMD_I2C=y
CONFIG_CMD_USB=y
CONFIG_CMD_USB_MASS_STORAGE=y
CONFIG_CMD_GPIO=y
CONFIG_CMD_DHCP=y
CONFIG_CMD_MII=y
CONFIG_CMD_PING=y
CONFIG_CMD_CACHE=y
CONFIG_CMD_PMIC=y
CONFIG_CMD_REGULATOR=y
CONFIG_CMD_EXT2=y
CONFIG_CMD_EXT4=y
CONFIG_CMD_EXT4_WRITE=y
CONFIG_CMD_FAT=y
CONFIG_CMD_BMP=y
CONFIG_DFU_MMC=y
CONFIG_DFU_RAM=y
CONFIG_DM_ETH=y
CONFIG_DM_ETH_PHY=y
CONFIG_FEC_MXC=y
CONFIG_RGMII=y
CONFIG_MII=y
CONFIG_DM_GPIO=y
CONFIG_DM_I2C=y
CONFIG_DM_MMC=y
CONFIG_SUPPORT_EMMC_BOOT=y
CONFIG_FSL_USDHC=y
CONFIG_DM_PMIC_PFUZE100=y
CONFIG_DM_PMIC=y
CONFIG_DM_REGULATOR_FIXED=y
CONFIG_DM_REGULATOR_GPIO=y
CONFIG_DM_REGULATOR_PFUZE100=y
CONFIG_DM_REGULATOR=y
CONFIG_DM_SPI=y
CONFIG_SOFT_SPI=y
CONFIG_DM_SPI_FLASH=y
CONFIG_SF_DEFAULT_MODE=0
CONFIG_SF_DEFAULT_SPEED=40000000
CONFIG_DM_USB=y
CONFIG_CMD_SAVEENV=y
CONFIG_ENV_IS_IN_MMC=y
CONFIG_MMC_IO_VOLTAGE=y
CONFIG_MMC_UHS_SUPPORT=y
# CONFIG_MMC_HS200_SUPPORT is not set
CONFIG_SPI=y
CONFIG_SPI_FLASH_MACRONIX=y
CONFIG_SPI_FLASH_STMICRO=y
CONFIG_SPI_FLASH_ISSI=y
CONFIG_PHYLIB=y
CONFIG_PHY_BROADCOM=y
CONFIG_PINCTRL=y
CONFIG_PINCTRL_IMX7=y
CONFIG_SOFT_SPI=y
CONFIG_USB=y
CONFIG_USB_EHCI_HCD=y
CONFIG_MXC_USB_OTG_HACTIVE=y
CONFIG_USB_STORAGE=y
CONFIG_USB_GADGET=y
CONFIG_CI_UDC=y
CONFIG_USB_GADGET_DOWNLOAD=y
CONFIG_USB_GADGET_MANUFACTURER="FSL"
CONFIG_USB_GADGET_VENDOR_NUM=0x0525
CONFIG_USB_GADGET_PRODUCT_NUM=0xa4a5
CONFIG_USB_HOST_ETHER=y
CONFIG_USB_ETHER_ASIX=y
CONFIG_ERRNO_STR=y
# CONFIG_VIDEO_SW_CURSOR is not set
CONFIG_OF_LIBFDT=y
CONFIG_OF_CONTROL=y
CONFIG_OF_BOARD_FIXUP=y
CONFIG_FSL_QSPI=y
CONFIG_CMD_EADISP=y
CONFIG_CMD_FASTBOOT=y
CONFIG_USB_FUNCTION_FASTBOOT=y
CONFIG_FASTBOOT_UUU_SUPPORT=y
CONFIG_FASTBOOT=y
CONFIG_FASTBOOT_BUF_ADDR=0x83800000
CONFIG_FASTBOOT_BUF_SIZE=0x40000000
CONFIG_FASTBOOT_FLASH=y
CONFIG_EFI_PARTITION=y
CONFIG_DEFAULT_DEVICE_TREE="imx7dea-com-kit"
CONFIG_SYS_RELOC_GD_ENV_ADDR=y
CONFIG_SYS_MMCSD_RAW_MODE_U_BOOT_USE_SECTOR=y
CONFIG_SYS_MMCSD_RAW_MODE_U_BOOT_SECTOR=0x8a
```

## configs/mx7dea-ucom-ptp_defconfig
```kconfig
CONFIG_SYS_EXTRA_OPTIONS="IMX_CONFIG=board/embeddedartists/mx7dea-ucom/imximage.cfg,MX7D,EA_IMX_PTP"
CONFIG_ARM=y
CONFIG_ARCH_MX7=y
CONFIG_TARGET_MX7DEA_UCOM=y
CONFIG_IMX_RDC=y
CONFIG_IMX_BOOTAUX=y
CONFIG_CMD_GPIO=y
CONFIG_CMD_DHCP=y
CONFIG_CMD_PING=y
```
